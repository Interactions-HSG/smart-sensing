## aamas23-paper/supplementary-material/thingy-hardware/thingy53-bdi-coap-client/boards/arm/thingy53/Kconfig.board
```kconfig
# Copyright (c) 2023 Nordic Semiconductor ASA
# SPDX-License-Identifier: Apache-2.0

config BOARD_THINGY53
	bool "thingy53"
	depends on SOC_NRF5340_CPUAPP_QKAA
```

## aamas23-paper/supplementary-material/thingy-hardware/thingy53-bdi-coap-client/boards/arm/thingy53/Kconfig.defconfig
```kconfig
# Copyright (c) 2023 Nordic Semiconductor ASA
# SPDX-License-Identifier: Apache-2.0

if BOARD_THINGY53

config BOARD
	default "thingy53"


endif
```
